## config/boards/shields/corne/Kconfig.defconfig
```kconfig
if SHIELD_CORNE_CENTRAL_DONGLE || SHIELD_CORNE_CENTRAL_LEFT

# Max 16 characters in keyboard name
config ZMK_KEYBOARD_NAME
    default "Corne"

config ZMK_SPLIT_ROLE_CENTRAL
    default y

endif

if SHIELD_CORNE_CENTRAL_DONGLE || SHIELD_CORNE_CENTRAL_LEFT || SHIELD_CORNE_PERIPHERAL_LEFT || SHIELD_CORNE_PERIPHERAL_RIGHT

config ZMK_SPLIT
    default y

endif
```

## config/west.yml
```yaml
manifest:
#  defaults:
#    revision: v0.3
  remotes:
    - name: zmkfirmware
      url-base: https://github.com/zmkfirmware
    - name: carrefinho                            # <--- add this
      url-base: https://github.com/carrefinho     # <--- and this
    #- name: janpfischer
    #  url-base: https://github.com/janpfischer
    # Additional modules containing boards/shields/custom code can be listed here as well
    # See https://docs.zephyrproject.org/3.2.0/develop/west/manifest.html#projects
  projects:
    - name: zmk
      remote: zmkfirmware
      revision: main
      import: app/west.yml
    - name: prospector-zmk-module                 # <--- and these
      remote: carrefinho                          # <---
      revision: feat/new-status-screens           # <---
    # - name: zmk-dongle-screen
    #   remote: janpfischer
    #   revision: main
  self:
    path: config
```
